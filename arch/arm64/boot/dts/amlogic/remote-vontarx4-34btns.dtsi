// SPDX-License-Identifier: (GPL-2.0+ OR MIT)
#include <dt-bindings/input/input.h>
#include <dt-bindings/input/meson_ir.h>

&custom_maps {
		mapnum = <2>;
		map1 = <&map_1>;
		map_1: map_1{
			mapname = "vontarx4-ir";
			customcode = <0xfe01>;
			release_delay = <0x50>;
			fn_key_scancode = <0x00>;
			cursor_left_scancode = <0x51>;
			cursor_right_scancode = <0x50>;
			cursor_up_scancode = <0x16>;
			cursor_down_scancode = <0x1a>;
			cursor_ok_scancode = <0x13>;
			size = <34>;
			keymap = <REMOTE_KEY(0x4e, KEY_1)
				REMOTE_KEY(0xd, KEY_2)
				REMOTE_KEY(0xc, KEY_3)
				REMOTE_KEY(0x4a, KEY_4)
				REMOTE_KEY(0x9, KEY_5)
				REMOTE_KEY(0x8, KEY_6)
				REMOTE_KEY(0x46, KEY_7)
				REMOTE_KEY(0x5, KEY_8)
				REMOTE_KEY(0x4, KEY_9)
				REMOTE_KEY(0x1, KEY_0)
				REMOTE_KEY(0x4c, KEY_MENU)
				REMOTE_KEY(0x18, KEY_VOLUMEUP)
				REMOTE_KEY(0x10, KEY_VOLUMEDOWN)
				REMOTE_KEY(0x11, KEY_HOME)
				REMOTE_KEY(0x50, KEY_RIGHT)
				REMOTE_KEY(0x51, KEY_LEFT)
				REMOTE_KEY(0x16, KEY_UP)
				REMOTE_KEY(0x1a, KEY_DOWN)
				REMOTE_KEY(0x13, KEY_ENTER)
				REMOTE_KEY(0x41, KEY_MUTE)
				REMOTE_KEY(0x19, KEY_BACK)
				REMOTE_KEY(0x40, KEY_POWER)
				REMOTE_KEY(0x4b, KEY_PAGEUP)
				REMOTE_KEY(0x4f, KEY_PAGEDOWN)
				REMOTE_KEY(0x0, KEY_PLAYPAUSE)
				REMOTE_KEY(0x42, KEY_BACKSPACE)
				REMOTE_KEY(0x92, KEY_F1)
				REMOTE_KEY(0x93, KEY_F2)
				REMOTE_KEY(0xcc, KEY_F3)
				REMOTE_KEY(0x8e, KEY_F4)
				REMOTE_KEY(0x8f, KEY_F5)
				REMOTE_KEY(0xc8, KEY_F6)
				REMOTE_KEY(0x43, KEY_F7)
				REMOTE_KEY(0xf, KEY_F8)>;
		};
};

